## prj.conf
```kconfig
# --- 1. ENABLE TENSORFLOW (CRITICAL MISSING LINE) ---
CONFIG_TENSORFLOW_LITE_MICRO=y
CONFIG_SIZE_OPTIMIZATIONS=y
# --- 2. C++ CONFIGURATION ---
CONFIG_CPP=y
CONFIG_STD_CPP17=y


# --- 3. C LIBRARY ---
CONFIG_NEWLIB_LIBC=y
CONFIG_NEWLIB_LIBC_FLOAT_PRINTF=y
CONFIG_NEWLIB_LIBC_FLOAT_SCANF=y

# --- 4. MEMORY (Increased for AI) ---
CONFIG_MAIN_STACK_SIZE=8192
CONFIG_HEAP_MEM_POOL_SIZE=4096
CONFIG_SYSTEM_WORKQUEUE_STACK_SIZE=4096
CONFIG_ISR_STACK_SIZE=4096

# --- 5. HARDWARE ---
CONFIG_FPU=y
CONFIG_FPU_SHARING=y
CONFIG_GPIO=y
CONFIG_AUDIO=y
CONFIG_AUDIO_DMIC=y

# --- 6. LOGGING ---
CONFIG_LOG=y
CONFIG_PRINTK=y
CONFIG_LOG_MODE_IMMEDIATE=y
# --- DISPLAY CONFIGURATION ---
CONFIG_I2C=y
CONFIG_DISPLAY=y
CONFIG_SSD1306=y
CONFIG_CHARACTER_FRAMEBUFFER=y
# --- 7. CMSIS-DSP MATH LIBRARY ---
CONFIG_CMSIS_DSP=y
CONFIG_CMSIS_DSP_MATRIX=y
CONFIG_CMSIS_DSP_COMPLEXMATH=y
CONFIG_CMSIS_DSP_TRANSFORM=y
CONFIG_CMSIS_DSP_STATISTICS=y
CONFIG_CMSIS_DSP_FILTERING=y
# --- 8. POWER & PERFORMANCE ---
CONFIG_PM=y
CONFIG_PM_DEVICE=y
CONFIG_PM_DEVICE_RUNTIME=y
```

## src/main.cpp
```c
#include <stdio.h>
#include <string.h>
#include <math.h>

#include <zephyr/kernel.h>
#include <zephyr/audio/dmic.h>
#include <zephyr/drivers/gpio.h>
#include <zephyr/pm/device.h>
#include <zephyr/pm/device_runtime.h>
#include <zephyr/sys_clock.h>
#include <arm_math.h>
#include <arm_const_structs.h>
#include <algorithm>

#include "tensorflow/lite/micro/micro_mutable_op_resolver.h"
#include "tensorflow/lite/micro/micro_interpreter.h"
#include "tensorflow/lite/schema/schema_generated.h"
#include "model_data.h"
#include "dsp_constants.h"

// ── 1. CONFIGURATION 

#define SAMPLE_RATE      16000
#define TOTAL_SECONDS    1.5f
#define DISCARD_SECONDS  0.5f
#define INF_SECONDS      1.0f

#define TOTAL_SAMPLES    ((int)(SAMPLE_RATE * TOTAL_SECONDS))    // 24,000
#define DISCARD_SAMPLES  ((int)(SAMPLE_RATE * DISCARD_SECONDS))  //  8,000
#define INF_SAMPLES      ((int)(SAMPLE_RATE * INF_SECONDS))      // 16,000
#define BLOCK_SIZE       2048

#define N_MFCC           13
#define FFT_SIZE         512
#define HOP_LENGTH       512
#define TIME_STEPS       (INF_SAMPLES / HOP_LENGTH)   // 31
#define N_BINS           (FFT_SIZE / 2 + 1)           // 257

// ── 2. HARDWARE NODES 

static const struct device *const dmic_dev =
    DEVICE_DT_GET(DT_NODELABEL(dmic_dev));
static const struct gpio_dt_spec button =
    GPIO_DT_SPEC_GET(DT_ALIAS(sw0),  gpios);
//static const struct gpio_dt_spec led0 = GPIO_DT_SPEC_GET(DT_ALIAS(led0), gpios);

// ── 3. AUDIO GLOBALS 

static int16_t rx_buffer[TOTAL_SAMPLES];
K_MEM_SLAB_DEFINE_STATIC(mem_slab, BLOCK_SIZE, 8, 4);

static K_SEM_DEFINE(button_sem, 0, 1);
static struct gpio_callback button_cb_data;

// ── 4. DSP BUFFERS 
// All static — no VLAs, no stack pressure.

static arm_rfft_fast_instance_f32 rfft_inst;

static float32_t frame_buf[FFT_SIZE];   // windowed audio frame
static float32_t fft_buf[FFT_SIZE];     // complex RFFT output (interleaved re/im)
static float32_t power_buf[N_BINS];     // |X[k]|^2
static float32_t mel_buf[N_MFCC];      // mel filterbank energy
static float32_t log_mel_buf[N_MFCC];  // ln(mel_energy)
static float32_t mfcc_buf[N_MFCC];     // DCT-II output

// Precomputed cumulative offsets into mel_filters_packed[]
static uint32_t filter_coef_offset[N_MFCC];

// ── 5. AI BUFFERS 

constexpr int kArenaSize = 10 * 1024;
alignas(16) static uint8_t tensor_arena[kArenaSize];

static tflite::MicroInterpreter *interpreter = nullptr;
static TfLiteTensor *input_tensor            = nullptr;
static TfLiteTensor *output_tensor           = nullptr;

// ── 6. BUTTON ISR 

static void button_isr(const struct device *dev,
                        struct gpio_callback *cb,
                        uint32_t pins)
{
    k_sem_give(&button_sem);
}
static void compute_mfcc_for_frame(const float32_t *audio_frame,
                                    float32_t       *mfcc_out)
{
    // Step 1: Hann window
    arm_mult_f32(audio_frame,
                 const_cast<float32_t *>(hann_window),
                 frame_buf,
                 FFT_SIZE);

    // Step 2: Real FFT
    // Layout: [re0, re_N/2, re1, im1, re2, im2, ..., re_{N/2-1}, im_{N/2-1}]
    arm_rfft_fast_f32(&rfft_inst, frame_buf, fft_buf, 0 /* forward */);

    // Step 3: Power spectrum
    // DC (k=0) and Nyquist (k=N/2) are packed as pure reals in fft_buf[0..1]
    power_buf[0]          = fft_buf[0] * fft_buf[0];
    power_buf[N_BINS - 1] = fft_buf[1] * fft_buf[1];
    for (int k = 1; k < N_BINS - 1; k++) {
        float re = fft_buf[2 * k];
        float im = fft_buf[2 * k + 1];
        power_buf[k] = re * re + im * im;
    }

    // Step 4: Sparse mel filterbank
    for (int m = 0; m < N_MFCC; m++) {
        float32_t energy = 0.0f;
        arm_dot_prod_f32(
            &power_buf[mel_filter_pos[m]],
            const_cast<float32_t *>(&mel_filters_packed[filter_coef_offset[m]]),
            mel_filter_len[m],
            &energy);
        mel_buf[m] = energy;
    }

    // Step 5: Natural log — +1e-6 prevents -inf on silent frames
    for (int m = 0; m < N_MFCC; m++) {
        log_mel_buf[m] = logf(mel_buf[m] + 1e-6f);
    }

    // Step 6: DCT-II via matrix-vector multiply
    arm_matrix_instance_f32 dct_mat;
    arm_mat_init_f32(&dct_mat,
                     N_MFCC, N_MFCC,
                     const_cast<float32_t *>(dct_coefs));
    arm_mat_vec_mult_f32(&dct_mat, log_mel_buf, mfcc_out);
}

// ── 8. AI SETUP 

static void setup_ai(void)
{
    printk("Initializing AI system (manual MFCC pipeline)...\n");

    // Initialise RFFT — the only CMSIS-DSP init needed
    if (arm_rfft_fast_init_f32(&rfft_inst, FFT_SIZE) != ARM_MATH_SUCCESS) {
        printk("ERROR: RFFT init failed!\n");
        return;
    }

    // Precompute cumulative offsets into mel_filters_packed[]
    // filter_coef_offset[m] = sum of mel_filter_len[0 .. m-1]
    uint32_t offset = 0;
    for (int m = 0; m < N_MFCC; m++) {
        filter_coef_offset[m] = offset;
        offset += mel_filter_len[m];
    }
    printk("RFFT ready. Mel filter offsets computed. Total packed coeffs: %u\n",
           (unsigned)offset);

    // Load TFLite model
    const tflite::Model *model = tflite::GetModel(g_audio_model_v2);

    static tflite::MicroMutableOpResolver<17> resolver;
    resolver.AddExpandDims();
    resolver.AddReshape();
    resolver.AddShape();
    resolver.AddStridedSlice();
    resolver.AddPack();
    resolver.AddConv2D();
    resolver.AddMaxPool2D();
    resolver.AddFullyConnected();
    resolver.AddLogistic();
    resolver.AddMul();
    resolver.AddAdd();
    resolver.AddMean();
    resolver.AddQuantize();
    resolver.AddDequantize();
    resolver.AddPad();
    resolver.AddDepthwiseConv2D();
    resolver.AddReduceMax();

    static tflite::MicroInterpreter static_interpreter(
        model, resolver, tensor_arena, kArenaSize);
    interpreter = &static_interpreter;

    if (interpreter->AllocateTensors() != kTfLiteOk) {
        printk("ERROR: Tensor allocation failed!\n");
        return;
    }

    input_tensor  = interpreter->input(0);
    output_tensor = interpreter->output(0);

    size_t used = interpreter->arena_used_bytes();
    printk("AI Ready. Arena: %u / %u bytes (%u%% used)\n",
           (unsigned)used,
           (unsigned)kArenaSize,
           (unsigned)((used * 100) / kArenaSize));
}

// ── 9. AUDIO RECORDING 

static void record_audio(void)
{
    uint32_t bytes_recorded      = 0;
    const uint32_t discard_bytes = (uint32_t)DISCARD_SAMPLES * sizeof(int16_t);
    bool speak_led_on            = false;

    struct pcm_stream_cfg stream = {
        .pcm_rate   = SAMPLE_RATE,
        .pcm_width  = 16,
        .block_size = BLOCK_SIZE,
        .mem_slab   = &mem_slab
    };
    struct dmic_cfg cfg = {
        .io = {
            .min_pdm_clk_freq = 1000000,
            .max_pdm_clk_freq = 3500000
        },
        .streams = &stream,
        .channel = {
            .req_chan_map_lo = dmic_build_channel_map(0, 0, PDM_CHAN_LEFT),
            .req_chan_map_hi = 0,
            .req_num_chan    = 1,
            .req_num_streams = 1
        }
    };

    if (dmic_configure(dmic_dev, &cfg) < 0) {
        printk("ERROR: DMIC configuration failed!\n");
        return;
    }
    printk("Warming up mic...\n");
    dmic_trigger(dmic_dev, DMIC_TRIGGER_START);

    while (bytes_recorded < sizeof(rx_buffer)) {
        void    *buffer;
        uint32_t size;

        if (dmic_read(dmic_dev, 0, &buffer, &size, 1000) < 0) {
            printk("ERROR: DMIC read failed!\n");
            break;
        }

        if (bytes_recorded + size <= sizeof(rx_buffer)) {
            memcpy((uint8_t *)rx_buffer + bytes_recorded, buffer, size);
        }
        bytes_recorded += size;

        // Switch LED on as soon as the discard window has passed
        if (!speak_led_on && bytes_recorded >= discard_bytes) {
            //gpio_pin_set_dt(&led0, 0);  // LED ON — speak now
            printk("SPEAK NOW\n");
            speak_led_on = true;
        }

        k_mem_slab_free(&mem_slab, buffer);
    }

    dmic_trigger(dmic_dev, DMIC_TRIGGER_STOP);
    //gpio_pin_set_dt(&led0, 1);  // LED OFF — done recording
    printk("Recording complete.\n");
}

// ── 10. INFERENCE WITH SEPARATE TIMING 
//
// Timing breakdown:
//   dsp_us   – time spent extracting all MFCC frames (compute_mfcc_for_frame
//               for every TIME_STEPS hop, including normalisation & quantisation)
//   invoke_us – time spent inside interpreter->Invoke() only


static void run_inference(void)
{
    if (interpreter == nullptr) {
        printk("ERROR: Interpreter not initialised.\n");
        return;
    }

    if (input_tensor == nullptr || output_tensor == nullptr) {
        printk("ERROR: Input or output tensor is not initialised.\n");
        return;
    }

    int8_t *input_ptr = tflite::GetTensorData<int8_t>(input_tensor);
    float32_t mfcc_sum = 0.0f;

    printk("Extracting MFCC features (%d frames x %d coefficients)...\n",
           TIME_STEPS, N_MFCC);

    // Start DSP timing
    uint32_t dsp_start = k_cycle_get_32();

    for (int t = 0; t < TIME_STEPS; t++) {
        const int base = DISCARD_SAMPLES + t * HOP_LENGTH;

        // Convert PCM audio samples to normalised floating-point values
        float32_t audio_in[FFT_SIZE];

        for (int i = 0; i < FFT_SIZE; i++) {
            audio_in[i] =
                static_cast<float32_t>(rx_buffer[base + i]) / 32768.0f;
        }

        // Calculate MFCC features for this frame
        compute_mfcc_for_frame(audio_in, mfcc_buf);

        // Normalise, quantise and store features in the input tensor
        // Tensor layout: [N_MFCC, TIME_STEPS]
        // Index: f * TIME_STEPS + t
        for (int f = 0; f < N_MFCC; f++) {
            const int idx = f * TIME_STEPS + t;

            const float normalised =
                (mfcc_buf[f] - PYTHON_MEAN) / PYTHON_STD;

            const float q =
                (normalised / input_tensor->params.scale) +
                input_tensor->params.zero_point;

            const float q_clamped =
                std::max(-128.0f, std::min(127.0f, q));

            input_ptr[idx] = static_cast<int8_t>(q_clamped);

            mfcc_sum += mfcc_buf[f];
        }
    }

    // End DSP timing
    const uint32_t dsp_us =
        k_cyc_to_us_near32(k_cycle_get_32() - dsp_start);

    printk("  [DBG] Mean raw MFCC: %d (x1000)\n",
           static_cast<int>(
               (mfcc_sum / (N_MFCC * TIME_STEPS)) * 1000.0f));

    // Start model inference timing
    const uint32_t invoke_start = k_cycle_get_32();

    const TfLiteStatus invoke_status = interpreter->Invoke();

    // End model inference timing
    const uint32_t invoke_us =
        k_cyc_to_us_near32(k_cycle_get_32() - invoke_start);

    if (invoke_status == kTfLiteOk) {
        const int8_t raw = output_tensor->data.int8[0];

        const float val =
            (static_cast<int>(raw) - output_tensor->params.zero_point) *
            output_tensor->params.scale;

        printk("\n>>> INFERENCE METRICS <<<\n");
        printk("DSP Time       : %u us (%u.%03u ms)\n",
               dsp_us, dsp_us / 1000, dsp_us % 1000);
        printk("Invoke Time    : %u us (%u.%03u ms)\n", invoke_us, invoke_us / 1000, invoke_us % 1000);
        printk("Total Time     : %u us (%u.%03u ms)\n", dsp_us + invoke_us,
               (dsp_us + invoke_us) / 1000,
               (dsp_us + invoke_us) % 1000);
        printk("Result         : %s\n", (val > 0.8f) ? "DETECTED" : "NOISE");
        printk("Confidence     : %d%%\n",
               static_cast<int>(val * 100.0f));
        printk("Arena Used     : %u bytes\n",
               static_cast<unsigned int>(
                   interpreter->arena_used_bytes()));
        printk("--------------------------\n");
    } else {
        printk("Inference Invoke Failed! Status: %d\n",
               static_cast<int>(invoke_status));
    }
}
// ── 11. MAIN 

int main(void)
{
    k_msleep(500);  // Allow USB-serial to settle
    printk("\n*** nRF54L15 Audio TinyML Benchmark ***\n");
    printk("    DSP: manual MFCC pipeline\n");
    printk("    Timing: DSP + Invoke() measured separately\n\n");

    if (!device_is_ready(dmic_dev)) {
        printk("ERROR: DMIC not ready!\n");
        return 0;
    }

    // Configure GPIO
    gpio_pin_configure_dt(&button, GPIO_INPUT | GPIO_PULL_UP);
    gpio_pin_interrupt_configure_dt(&button, GPIO_INT_EDGE_TO_ACTIVE);
    gpio_init_callback(&button_cb_data, button_isr, BIT(button.pin));
    gpio_add_callback(button.port, &button_cb_data);

    setup_ai();

    printk("Ready — press the button to record and classify.\n\n");

    while (1) {
        // Block until button press (ISR gives the semaphore)
        k_sem_take(&button_sem, K_FOREVER);

        pm_device_runtime_get(dmic_dev);
        record_audio();
        pm_device_runtime_put(dmic_dev);

        run_inference();

        printk("Press button to run again.\n\n");
    }
}
```

## src/dsp_constants.h
```c
#ifndef DSP_CONSTANTS_H
#define DSP_CONSTANTS_H

#include <stdint.h>

// Applied in C++ after computing all MFCC.
static const float PYTHON_MEAN = -2.38684797f;
static const float PYTHON_STD  = 12.36017513f;

// Hann window applied before FFT, length 512
static const float hann_window[512] = {
  0.00000000f, 0.00003780f, 0.00015118f, 0.00034013f, 0.00060463f, 0.00094463f, 0.00136008f, 0.00185091f,
  0.00241706f, 0.00305844f, 0.00377495f, 0.00456648f, 0.00543291f, 0.00637411f, 0.00738995f, 0.00848026f,
  0.00964488f, 0.01088363f, 0.01219634f, 0.01358279f, 0.01504278f, 0.01657609f, 0.01818249f, 0.01986173f,
  0.02161357f, 0.02343773f, 0.02533393f, 0.02730190f, 0.02934134f, 0.03145194f, 0.03363337f, 0.03588531f,
  0.03820742f, 0.04059934f, 0.04306072f, 0.04559118f, 0.04819034f, 0.05085782f, 0.05359319f, 0.05639606f,
  0.05926599f, 0.06220255f, 0.06520531f, 0.06827380f, 0.07140756f, 0.07460611f, 0.07786898f, 0.08119567f,
  0.08458568f, 0.08803850f, 0.09155359f, 0.09513044f, 0.09876850f, 0.10246722f, 0.10622604f, 0.11004440f,
  0.11392171f, 0.11785739f, 0.12185084f, 0.12590148f, 0.13000865f, 0.13417177f, 0.13839021f, 0.14266330f,
  0.14699043f, 0.15137093f, 0.15580413f, 0.16028938f, 0.16482598f, 0.16941325f, 0.17405050f, 0.17873703f,
  0.18347214f, 0.18825510f, 0.19308519f, 0.19796169f, 0.20288384f, 0.20785092f, 0.21286216f, 0.21791682f,
  0.22301412f, 0.22815330f, 0.23333357f, 0.23855416f, 0.24381429f, 0.24911314f, 0.25444993f, 0.25982383f,
  0.26523405f, 0.27067977f, 0.27616015f, 0.28167439f, 0.28722161f, 0.29280102f, 0.29841176f, 0.30405295f,
  0.30972379f, 0.31542337f, 0.32115087f, 0.32690543f, 0.33268613f, 0.33849216f, 0.34432256f, 0.35017651f,
  0.35605314f, 0.36195150f, 0.36787075f, 0.37380999f, 0.37976828f, 0.38574475f, 0.39173850f, 0.39774862f,
  0.40377420f, 0.40981433f, 0.41586810f, 0.42193457f, 0.42801285f, 0.43410203f, 0.44020116f, 0.44630933f,
  0.45242563f, 0.45854908f, 0.46467885f, 0.47081393f, 0.47695342f, 0.48309642f, 0.48924196f, 0.49538910f,
  0.50153697f, 0.50768459f, 0.51383108f, 0.51997548f, 0.52611679f, 0.53225422f, 0.53838676f, 0.54451346f,
  0.55063349f, 0.55674583f, 0.56284958f, 0.56894386f, 0.57502770f, 0.58110023f, 0.58716041f, 0.59320748f,
  0.59924048f, 0.60525841f, 0.61126047f, 0.61724567f, 0.62321317f, 0.62916207f, 0.63509142f, 0.64100033f,
  0.64688796f, 0.65275335f, 0.65859562f, 0.66441399f, 0.67020744f, 0.67597520f, 0.68171632f, 0.68742996f,
  0.69311529f, 0.69877142f, 0.70439750f, 0.70999265f, 0.71555609f, 0.72108692f, 0.72658432f, 0.73204744f,
  0.73747551f, 0.74286771f, 0.74822313f, 0.75354105f, 0.75882065f, 0.76406109f, 0.76926166f, 0.77442145f,
  0.77953982f, 0.78461587f, 0.78964895f, 0.79463822f, 0.79958290f, 0.80448234f, 0.80933571f, 0.81414235f,
  0.81890142f, 0.82361233f, 0.82827431f, 0.83288670f, 0.83744872f, 0.84195971f, 0.84641904f, 0.85082597f,
  0.85517985f, 0.85948002f, 0.86372590f, 0.86791676f, 0.87205195f, 0.87613094f, 0.88015306f, 0.88411772f,
  0.88802427f, 0.89187217f, 0.89566082f, 0.89938968f, 0.90305817f, 0.90666568f, 0.91021168f, 0.91369575f,
  0.91711718f, 0.92047560f, 0.92377049f, 0.92700124f, 0.93016744f, 0.93326867f, 0.93630433f, 0.93927401f,
  0.94217736f, 0.94501376f, 0.94778293f, 0.95048445f, 0.95311779f, 0.95568264f, 0.95817864f, 0.96060532f,
  0.96296239f, 0.96524948f, 0.96746618f, 0.96961224f, 0.97168732f, 0.97369105f, 0.97562313f, 0.97748339f,
  0.97927141f, 0.98098695f, 0.98262984f, 0.98419970f, 0.98569638f, 0.98711962f, 0.98846924f, 0.98974502f,
  0.99094671f, 0.99207419f, 0.99312729f, 0.99410582f, 0.99500966f, 0.99583864f, 0.99659270f, 0.99727166f,
  0.99787539f, 0.99840391f, 0.99885708f, 0.99923480f, 0.99953705f, 0.99976379f, 0.99991494f, 0.99999052f,
  0.99999052f, 0.99991494f, 0.99976379f, 0.99953705f, 0.99923480f, 0.99885708f, 0.99840391f, 0.99787539f,
  0.99727166f, 0.99659270f, 0.99583864f, 0.99500966f, 0.99410582f, 0.99312729f, 0.99207419f, 0.99094671f,
  0.98974502f, 0.98846924f, 0.98711962f, 0.98569638f, 0.98419970f, 0.98262984f, 0.98098695f, 0.97927141f,
  0.97748339f, 0.97562313f, 0.97369105f, 0.97168732f, 0.96961224f, 0.96746618f, 0.96524948f, 0.96296239f,
  0.96060532f, 0.95817864f, 0.95568264f, 0.95311779f, 0.95048445f, 0.94778293f, 0.94501376f, 0.94217736f,
  0.93927401f, 0.93630433f, 0.93326867f, 0.93016744f, 0.92700124f, 0.92377049f, 0.92047560f, 0.91711718f,
  0.91369575f, 0.91021168f, 0.90666568f, 0.90305817f, 0.89938968f, 0.89566082f, 0.89187217f, 0.88802427f,
  0.88411772f, 0.88015306f, 0.87613094f, 0.87205195f, 0.86791676f, 0.86372590f, 0.85948002f, 0.85517985f,
  0.85082597f, 0.84641904f, 0.84195971f, 0.83744872f, 0.83288670f, 0.82827431f, 0.82361233f, 0.81890142f,
  0.81414235f, 0.80933571f, 0.80448234f, 0.79958290f, 0.79463822f, 0.78964895f, 0.78461587f, 0.77953982f,
  0.77442145f, 0.76926166f, 0.76406109f, 0.75882065f, 0.75354105f, 0.74822313f, 0.74286771f, 0.73747551f,
  0.73204744f, 0.72658432f, 0.72108692f, 0.71555609f, 0.70999265f, 0.70439750f, 0.69877142f, 0.69311529f,
  0.68742996f, 0.68171632f, 0.67597520f, 0.67020744f, 0.66441399f, 0.65859562f, 0.65275335f, 0.64688796f,
  0.64100033f, 0.63509142f, 0.62916207f, 0.62321317f, 0.61724567f, 0.61126047f, 0.60525841f, 0.59924048f,
  0.59320748f, 0.58716041f, 0.58110023f, 0.57502770f, 0.56894386f, 0.56284958f, 0.55674583f, 0.55063349f,
  0.54451346f, 0.53838676f, 0.53225422f, 0.52611679f, 0.51997548f, 0.51383108f, 0.50768459f, 0.50153697f,
  0.49538910f, 0.48924196f, 0.48309642f, 0.47695342f, 0.47081393f, 0.46467885f, 0.45854908f, 0.45242563f,
  0.44630933f, 0.44020116f, 0.43410203f, 0.42801285f, 0.42193457f, 0.41586810f, 0.40981433f, 0.40377420f,
  0.39774862f, 0.39173850f, 0.38574475f, 0.37976828f, 0.37380999f, 0.36787075f, 0.36195150f, 0.35605314f,
  0.35017651f, 0.34432256f, 0.33849216f, 0.33268613f, 0.32690543f, 0.32115087f, 0.31542337f, 0.30972379f,
  0.30405295f, 0.29841176f, 0.29280102f, 0.28722161f, 0.28167439f, 0.27616015f, 0.27067977f, 0.26523405f,
  0.25982383f, 0.25444993f, 0.24911314f, 0.24381429f, 0.23855416f, 0.23333357f, 0.22815330f, 0.22301412f,
  0.21791682f, 0.21286216f, 0.20785092f, 0.20288384f, 0.19796169f, 0.19308519f, 0.18825510f, 0.18347214f,
  0.17873703f, 0.17405050f, 0.16941325f, 0.16482598f, 0.16028938f, 0.15580413f, 0.15137093f, 0.14699043f,
  0.14266330f, 0.13839021f, 0.13417177f, 0.13000865f, 0.12590148f, 0.12185084f, 0.11785739f, 0.11392171f,
  0.11004440f, 0.10622604f, 0.10246722f, 0.09876850f, 0.09513044f, 0.09155359f, 0.08803850f, 0.08458568f,
  0.08119567f, 0.07786898f, 0.07460611f, 0.07140756f, 0.06827380f, 0.06520531f, 0.06220255f, 0.05926599f,
  0.05639606f, 0.05359319f, 0.05085782f, 0.04819034f, 0.04559118f, 0.04306072f, 0.04059934f, 0.03820742f,
  0.03588531f, 0.03363337f, 0.03145194f, 0.02934134f, 0.02730190f, 0.02533393f, 0.02343773f, 0.02161357f,
  0.01986173f, 0.01818249f, 0.01657609f, 0.01504278f, 0.01358279f, 0.01219634f, 0.01088363f, 0.00964488f,
  0.00848026f, 0.00738995f, 0.00637411f, 0.00543291f, 0.00456648f, 0.00377495f, 0.00305844f, 0.00241706f,
  0.00185091f, 0.00136008f, 0.00094463f, 0.00060463f, 0.00034013f, 0.00015118f, 0.00003780f, 0.00000000f
};

// First non-zero power-spectrum bin for each mel filter
static const uint16_t mel_filter_pos[13] = {
  1, 7, 14, 21, 28, 35, 44, 55, 68, 85, 106, 132, 165
};

// Number of non-zero coefficients for each mel filter
static const uint16_t mel_filter_len[13] = {
  13, 14, 14, 14, 16, 20, 24, 30, 38, 47, 59, 73, 91
};

// Concatenated non-zero mel filter coefficients (453 total)
// Index into this array using filter_coef_offset[m] computed at startup
static const float mel_filters_packed[453] = {
  0.00067319f, 0.00134637f, 0.00201956f, 0.00269274f, 0.00336593f, 0.00403912f, 0.00457036f, 0.00389717f,
  0.00322399f, 0.00255080f, 0.00187762f, 0.00120443f, 0.00053124f, 0.00007097f, 0.00074416f, 0.00141734f,
  0.00209053f, 0.00276372f, 0.00343690f, 0.00411009f, 0.00449939f, 0.00382620f, 0.00315302f, 0.00247983f,
  0.00180664f, 0.00113346f, 0.00046027f, 0.00014194f, 0.00081513f, 0.00148832f, 0.00216150f, 0.00283469f,
  0.00350787f, 0.00418106f, 0.00442842f, 0.00375523f, 0.00308204f, 0.00240886f, 0.00173567f, 0.00106249f,
  0.00038930f, 0.00021015f, 0.00087458f, 0.00153901f, 0.00220344f, 0.00286787f, 0.00353230f, 0.00419673f,
  0.00430796f, 0.00366060f, 0.00301323f, 0.00236586f, 0.00171849f, 0.00107112f, 0.00042376f, 0.00024295f,
  0.00081906f, 0.00139517f, 0.00197129f, 0.00254740f, 0.00312351f, 0.00369962f, 0.00391342f, 0.00344062f,
  0.00296782f, 0.00249502f, 0.00202222f, 0.00154942f, 0.00107662f, 0.00060382f, 0.00013102f, 0.00013222f,
  0.00051501f, 0.00089779f, 0.00128058f, 0.00166336f, 0.00204615f, 0.00242894f, 0.00281172f, 0.00319451f,
  0.00307901f, 0.00277249f, 0.00246597f, 0.00215945f, 0.00185293f, 0.00154641f, 0.00123989f, 0.00093337f,
  0.00062685f, 0.00032033f, 0.00001382f, 0.00017743f, 0.00042288f, 0.00066833f, 0.00091377f, 0.00115922f,
  0.00140467f, 0.00165012f, 0.00189557f, 0.00214102f, 0.00238647f, 0.00263192f, 0.00245529f, 0.00225875f,
  0.00206220f, 0.00186565f, 0.00166911f, 0.00147256f, 0.00127602f, 0.00107947f, 0.00088293f, 0.00068638f,
  0.00048984f, 0.00029329f, 0.00009675f, 0.00015029f, 0.00030768f, 0.00046506f, 0.00062245f, 0.00077984f,
  0.00093722f, 0.00109461f, 0.00125199f, 0.00140938f, 0.00156676f, 0.00172415f, 0.00188153f, 0.00203892f,
  0.00205240f, 0.00192637f, 0.00180034f, 0.00167431f, 0.00154829f, 0.00142226f, 0.00129623f, 0.00117020f,
  0.00104417f, 0.00091814f, 0.00079212f, 0.00066609f, 0.00054006f, 0.00041403f, 0.00028800f, 0.00016198f,
  0.00003595f, 0.00005124f, 0.00015216f, 0.00025308f, 0.00035400f, 0.00045492f, 0.00055583f, 0.00065675f,
  0.00075767f, 0.00085859f, 0.00095951f, 0.00106043f, 0.00116134f, 0.00126226f, 0.00136318f, 0.00146410f,
  0.00156502f, 0.00166594f, 0.00163696f, 0.00155615f, 0.00147534f, 0.00139453f, 0.00131371f, 0.00123290f,
  0.00115209f, 0.00107128f, 0.00099047f, 0.00090966f, 0.00082885f, 0.00074803f, 0.00066722f, 0.00058641f,
  0.00050560f, 0.00042479f, 0.00034398f, 0.00026317f, 0.00018236f, 0.00010154f, 0.00002073f, 0.00004625f,
  0.00011096f, 0.00017567f, 0.00024038f, 0.00030509f, 0.00036981f, 0.00043452f, 0.00049923f, 0.00056394f,
  0.00062865f, 0.00069336f, 0.00075807f, 0.00082278f, 0.00088749f, 0.00095220f, 0.00101691f, 0.00108162f,
  0.00114633f, 0.00121104f, 0.00127575f, 0.00134046f, 0.00131854f, 0.00126672f, 0.00121491f, 0.00116309f,
  0.00111127f, 0.00105945f, 0.00100764f, 0.00095582f, 0.00090400f, 0.00085218f, 0.00080037f, 0.00074855f,
  0.00069673f, 0.00064491f, 0.00059310f, 0.00054128f, 0.00048946f, 0.00043764f, 0.00038583f, 0.00033401f,
  0.00028219f, 0.00023037f, 0.00017856f, 0.00012674f, 0.00007492f, 0.00002310f, 0.00003085f, 0.00007234f,
  0.00011383f, 0.00015533f, 0.00019682f, 0.00023831f, 0.00027981f, 0.00032130f, 0.00036280f, 0.00040429f,
  0.00044578f, 0.00048728f, 0.00052877f, 0.00057026f, 0.00061176f, 0.00065325f, 0.00069474f, 0.00073624f,
  0.00077773f, 0.00081922f, 0.00086072f, 0.00090221f, 0.00094370f, 0.00098520f, 0.00102669f, 0.00106818f,
  0.00106827f, 0.00103504f, 0.00100182f, 0.00096859f, 0.00093537f, 0.00090214f, 0.00086891f, 0.00083569f,
  0.00080246f, 0.00076923f, 0.00073601f, 0.00070278f, 0.00066956f, 0.00063633f, 0.00060310f, 0.00056988f,
  0.00053665f, 0.00050342f, 0.00047020f, 0.00043697f, 0.00040375f, 0.00037052f, 0.00033729f, 0.00030407f,
  0.00027084f, 0.00023761f, 0.00020439f, 0.00017116f, 0.00013794f, 0.00010471f, 0.00007148f, 0.00003826f,
  0.00000503f, 0.00001474f, 0.00004135f, 0.00006796f, 0.00009456f, 0.00012117f, 0.00014778f, 0.00017438f,
  0.00020099f, 0.00022759f, 0.00025420f, 0.00028081f, 0.00030741f, 0.00033402f, 0.00036063f, 0.00038723f,
  0.00041384f, 0.00044044f, 0.00046705f, 0.00049366f, 0.00052026f, 0.00054687f, 0.00057348f, 0.00060008f,
  0.00062669f, 0.00065329f, 0.00067990f, 0.00070651f, 0.00073311f, 0.00075972f, 0.00078633f, 0.00081293f,
  0.00083954f, 0.00086614f, 0.00085209f, 0.00083079f, 0.00080948f, 0.00078818f, 0.00076687f, 0.00074557f,
  0.00072426f, 0.00070296f, 0.00068165f, 0.00066035f, 0.00063904f, 0.00061773f, 0.00059643f, 0.00057512f,
  0.00055382f, 0.00053251f, 0.00051121f, 0.00048990f, 0.00046860f, 0.00044729f, 0.00042599f, 0.00040468f,
  0.00038338f, 0.00036207f, 0.00034077f, 0.00031946f, 0.00029816f, 0.00027685f, 0.00025555f, 0.00023424f,
  0.00021294f, 0.00019163f, 0.00017033f, 0.00014902f, 0.00012771f, 0.00010641f, 0.00008510f, 0.00006380f,
  0.00004249f, 0.00002119f, 0.00001448f, 0.00003154f, 0.00004860f, 0.00006566f, 0.00008272f, 0.00009978f,
  0.00011684f, 0.00013390f, 0.00015096f, 0.00016802f, 0.00018508f, 0.00020214f, 0.00021920f, 0.00023626f,
  0.00025332f, 0.00027038f, 0.00028744f, 0.00030450f, 0.00032156f, 0.00033862f, 0.00035568f, 0.00037275f,
  0.00038981f, 0.00040687f, 0.00042393f, 0.00044099f, 0.00045805f, 0.00047511f, 0.00049217f, 0.00050923f,
  0.00052629f, 0.00054335f, 0.00056041f, 0.00057747f, 0.00059453f, 0.00061159f, 0.00062865f, 0.00064571f,
  0.00066277f, 0.00067983f, 0.00069672f, 0.00068306f, 0.00066940f, 0.00065574f, 0.00064208f, 0.00062842f,
  0.00061476f, 0.00060110f, 0.00058743f, 0.00057377f, 0.00056011f, 0.00054645f, 0.00053279f, 0.00051913f,
  0.00050547f, 0.00049181f, 0.00047814f, 0.00046448f, 0.00045082f, 0.00043716f, 0.00042350f, 0.00040984f,
  0.00039618f, 0.00038252f, 0.00036885f, 0.00035519f, 0.00034153f, 0.00032787f, 0.00031421f, 0.00030055f,
  0.00028689f, 0.00027323f, 0.00025956f, 0.00024590f, 0.00023224f, 0.00021858f, 0.00020492f, 0.00019126f,
  0.00017760f, 0.00016394f, 0.00015027f, 0.00013661f, 0.00012295f, 0.00010929f, 0.00009563f, 0.00008197f,
  0.00006831f, 0.00005465f, 0.00004098f, 0.00002732f, 0.00001366f
};

// DCT-II orthonormal matrix, 13�13, row-major
// Used by arm_mat_vec_mult_f32: out[k] = sum_j dct_coefs[k*N+j]*log_mel[j]
static const float dct_coefs[169] = {
  0.27735010f, 0.27735010f, 0.27735010f, 0.27735010f, 0.27735010f, 0.27735010f, 0.27735010f, 0.27735010f,
  0.27735010f, 0.27735010f, 0.27735010f, 0.27735010f, 0.27735010f, 0.38937247f, 0.36674353f, 0.32280084f,
  0.26009810f, 0.18227942f, 0.09386732f, 0.00000000f, -0.09386732f, -0.18227942f, -0.26009810f, -0.32280084f,
  -0.36674353f, -0.38937247f, 0.38083470f, 0.29359007f, 0.13908748f, -0.04727837f, -0.22281332f, -0.34730443f,
  -0.39223227f, -0.34730443f, -0.22281332f, -0.04727837f, 0.13908748f, 0.29359007f, 0.38083470f, 0.36674353f,
  0.18227942f, -0.09386732f, -0.32280084f, -0.38937247f, -0.26009810f, -0.00000000f, 0.26009810f, 0.38937247f,
  0.32280084f, 0.09386732f, -0.18227942f, -0.36674353f, 0.34730443f, 0.04727837f, -0.29359007f, -0.38083470f,
  -0.13908748f, 0.22281332f, 0.39223227f, 0.22281332f, -0.13908748f, -0.38083470f, -0.29359007f, 0.04727837f,
  0.34730443f, 0.32280084f, -0.09386732f, -0.38937247f, -0.18227942f, 0.26009810f, 0.36674353f, 0.00000000f,
  -0.36674353f, -0.26009810f, 0.18227942f, 0.38937247f, 0.09386732f, -0.32280084f, 0.29359007f, -0.22281332f,
  -0.34730443f, 0.13908748f, 0.38083470f, -0.04727837f, -0.39223227f, -0.04727837f, 0.38083470f, 0.13908748f,
  -0.34730443f, -0.22281332f, 0.29359007f, 0.26009810f, -0.32280084f, -0.18227942f, 0.36674353f, 0.09386732f,
  -0.38937247f, 0.00000000f, 0.38937247f, -0.09386732f, -0.36674353f, 0.18227942f, 0.32280084f, -0.26009810f,
  0.22281332f, -0.38083470f, 0.04727837f, 0.34730443f, -0.29359007f, -0.13908748f, 0.39223227f, -0.13908748f,
  -0.29359007f, 0.34730443f, 0.04727837f, -0.38083470f, 0.22281332f, 0.18227942f, -0.38937247f, 0.26009810f,
  0.09386732f, -0.36674353f, 0.32280084f, -0.00000000f, -0.32280084f, 0.36674353f, -0.09386732f, -0.26009810f,
  0.38937247f, -0.18227942f, 0.13908748f, -0.34730443f, 0.38083470f, -0.22281332f, -0.04727837f, 0.29359007f,
  -0.39223227f, 0.29359007f, -0.04727837f, -0.22281332f, 0.38083470f, -0.34730443f, 0.13908748f, 0.09386732f,
  -0.26009810f, 0.36674353f, -0.38937247f, 0.32280084f, -0.18227942f, 0.00000000f, 0.18227942f, -0.32280084f,
  0.38937247f, -0.36674353f, 0.26009810f, -0.09386732f, 0.04727837f, -0.13908748f, 0.22281332f, -0.29359007f,
  0.34730443f, -0.38083470f, 0.39223227f, -0.38083470f, 0.34730443f, -0.29359007f, 0.22281332f, -0.13908748f,
  0.04727837f
};

#endif // DSP_CONSTANTS_H
```
